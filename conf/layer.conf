## conf/layer.conf
```bitbake
# We have a conf and classes directory, add to BBPATH
BBPATH .= ":${LAYERDIR}"

# We have recipes-* directories, add to BBFILES
BBFILES += "${LAYERDIR}/recipes-*/*/*.bb \
            ${LAYERDIR}/recipes-*/*/*.bbappend"

BBFILE_COLLECTIONS += "meta-openai"
BBFILE_PATTERN_meta-openai = "^${LAYERDIR}/"
BBFILE_PRIORITY_meta-openai = "6"

LAYERDEPENDS_meta-openai = "core"
LAYERSERIES_COMPAT_meta-openai = "kirkstone langdale"
```
